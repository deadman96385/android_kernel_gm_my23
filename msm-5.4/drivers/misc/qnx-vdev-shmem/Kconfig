## msm-5.4/drivers/misc/qnx-vdev-shmem/Kconfig
```kconfig
# SPDX-License-Identifier: GPL-2.0-only
#
# Makefile for qvm-shmem kernel module
# which is used to remount the Android
# FS when there is SoH failure.
#
config QVM_SHMEM
	tristate "QVM SHMEM kernel module"
	default m
	help
	  Sends the signal to android_remounter daemon to remount the android FS
	  when there is an SoH failure.

	  If unsure, say N.

	  To compile this driver as a module, choose M here: the
	  module will be called qvm-shmem.ko.
```

## msm-5.4/security/gm/Kconfig
```kconfig
# Copyright © 2021 General Motors Co open.source@gm.com
#
# This library is free software; you can redistribute it and/or
# modify it under the terms of the GNU General Public
# License as published by the Free Software Foundation; version 2.0
# of the License or any later version. This library is distributed in
# the hope that it will be useful, but WITHOUT ANY WARRANTY; without
# even the implied warranty of MERCHANTABILITY or FITNESS FOR A
# PARTICULAR PURPOSE. See the GNU General Public License 2 for more details.
#
# The source for this package can be downloaded at:
# https://www.oss.gm.com/GMNA/7E7/IVAIVD
#
# GM security module configuration
#

config GM_SIGNATURE
	bool "GM persistent data and credential store security signature"
	default y
	help
	  This option enables digital signature support for GM persistent secure hash (proto-key)
	  generated and maintained by out-of-box GM Body Control Module ECU (BCM).
```
